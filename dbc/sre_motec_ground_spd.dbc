VERSION ""

NS_ :

BS_:

BU_: DBG DAQ

BO_ 1296 VCU_Ground_Speed_Motor: 8 DAQ
 SG_ VCU_Ground_Speed_Motor_Kph : 0|16@1- (0.01,0) [-32768|32767] "Kph" DAQ

CM_ BU_ DAQ "The data acquisition unit";

BA_DEF_ "BusType" STRING ;
BA_DEF_ SG_ "FieldType" STRING ;

BA_DEF_DEF_ "BusType" "CAN";
BA_DEF_DEF_ "FieldType" "";

BA_ "FieldType" SG_ 100 DRIVER_HEARTBEAT_cmd "DRIVER_HEARTBEAT_cmd";

VAL_ 100 DRIVER_HEARTBEAT_cmd 2 "DRIVER_HEARTBEAT_cmd_REBOOT" 1 "DRIVER_HEARTBEAT_cmd_SYNC" 0 "DRIVER_HEARTBEAT_cmd_NOOP" ;
