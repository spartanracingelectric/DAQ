VERSION ""

NS_ :

BS_:

BU_: DBG DAQ S2C

BO_ 1796 S2C_MPRLS_Pressure_1: 8 DAQ
 SG_ S2C_MPRLS0_Pressure : 0|32@1+ (0.01,0) [0|100000] "hPa" S2C
 SG_ S2C_MPRLS1_Pressure : 32|32@1+ (0.01,0) [0|100000] "hPa" S2C

CM_ BU_ DAQ "The data acquisition unit";

BA_DEF_ "BusType" STRING ;
BA_DEF_ SG_ "FieldType" STRING ;

BA_DEF_DEF_ "BusType" "CAN";
BA_DEF_DEF_ "FieldType" "";

BA_ "FieldType" SG_ 100 DRIVER_HEARTBEAT_cmd "DRIVER_HEARTBEAT_cmd";

VAL_ 100 DRIVER_HEARTBEAT_cmd 2 "DRIVER_HEARTBEAT_cmd_REBOOT" 1 "DRIVER_HEARTBEAT_cmd_SYNC" 0 "DRIVER_HEARTBEAT_cmd_NOOP" ;
